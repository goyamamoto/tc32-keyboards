## boards/cidoo/cidoo_v21/Kconfig.cidoo_v21
```kconfig
# SPDX-License-Identifier: GPL-3.0-or-later

config BOARD_CIDOO_V21
	select SOC_TLSR8278
```

## boards/cidoo/cidoo_v21/board.yml
```yaml
# SPDX-License-Identifier: GPL-3.0-or-later
board:
  name: cidoo_v21
  full_name: CIDOO V21
  vendor: cidoo
  socs:
    - name: tlsr8278
```

## boards/cidoo/cidoo_v65v3/Kconfig
```kconfig
# SPDX-License-Identifier: GPL-3.0-or-later

config STATUS_DISPLAY_CIDOO_V65V3
	bool
	default y
	depends on TLSR_STATUS_DISPLAY && LED_DRIVER_SPI && BOARD_CIDOO_V65V3
	help
	  v65v3_status.c: the status display on the V65 V3's LEDs through
	  the backlight driver's overlay - the battery on 1 to 0, the CPU left
	  over on Z to /, the Bluetooth profiles on Q, W and E, the 2.4G link
	  on R, the Windows or Mac mode on A or S.
```

## boards/cidoo/cidoo_v65v3/Kconfig.cidoo_v65v3
```kconfig
# SPDX-License-Identifier: GPL-3.0-or-later

config BOARD_CIDOO_V65V3
	select SOC_TLSR8278
```

## boards/cidoo/cidoo_v65v3/board.yml
```yaml
# SPDX-License-Identifier: GPL-3.0-or-later
board:
  name: cidoo_v65v3
  full_name: CIDOO V65 V3
  vendor: cidoo
  socs:
    - name: tlsr8278
```

## boards/cidoo/cidoo_v75pro/Kconfig
```kconfig
# SPDX-License-Identifier: GPL-3.0-or-later

config STATUS_DISPLAY_CIDOO_V75PRO
	bool
	default y
	depends on TLSR_STATUS_DISPLAY && LED_DRIVER_SPI && BOARD_CIDOO_V75PRO
	help
	  v75pro_status.c: the status display on the V75 Pro's LEDs
	  through the backlight driver's overlay - the battery on the three
	  LEDs left of the knob, the Bluetooth profiles on Q, W and E, the
	  2.4G link on R, the CPU left over on 1 to 0.
```

## boards/cidoo/cidoo_v75pro/Kconfig.cidoo_v75pro
```kconfig
# SPDX-License-Identifier: GPL-3.0-or-later

config BOARD_CIDOO_V75PRO
	select SOC_TLSR8278
```

## boards/cidoo/cidoo_v75pro/board.yml
```yaml
# SPDX-License-Identifier: GPL-3.0-or-later
board:
  name: cidoo_v75pro
  full_name: CIDOO V75 Pro
  vendor: cidoo
  socs:
    - name: tlsr8278
```
